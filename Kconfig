## Kconfig
```kconfig
# SPDX-License-Identifier: Apache-2.0

menu "MIDI 1.0 Support"

rsource "drivers/midi/serial/Kconfig"
rsource "drivers/midi/clock/Kconfig"
rsource "drivers/midi/measurement/Kconfig"
rsource "lib/harmonic/Kconfig"

endmenu
```

## drivers/midi/clock/Kconfig
```kconfig
# SPDX-License-Identifier: Apache-2.0

config MIDI1_CLOCK_CNTR
    bool "MIDI1 clock generator driver"
    default y
```

## drivers/midi/measurement/Kconfig
```kconfig
# SPDX-License-Identifier: Apache-2.0

config MIDI1_CLOCK_MEAS_CNTR
    bool "MIDI1 clock measurement counter driver"
    default n
    select COUNTER

config MIDI1_CLOCK_MEAS_BLOCKAVG_SIZE
    int "Clock measurement block average size"
    default 6
```

## drivers/midi/serial/Kconfig
```kconfig
# SPDX-License-Identifier: Apache-2.0

config MIDI1_SERIAL
    bool "MIDI1 serial UART driver"
    default n
    depends on DT_HAS_MIDI1_SERIAL_ENABLED
    select SERIAL
    select UART_INTERRUPT_DRIVEN
    select RING_BUFFER
    help
      Enable the MIDI 1.0 Serial (UART) driver. This driver provides
      bidirectional MIDI 1.0 communication over a UART device using
      interrupt-driven I/O and optional running status.

config MIDI1_SERIAL_CHANNEL
    int "MIDI channel to use (1-16)"
    default 1
    range 1 16

config MIDI1_SERIAL_RUNNING_STATUS_REPEAT
    int "MIDI1 Serial Running status"
    default 16

config MIDI1_SERIAL_RUNNING_STATUS_TIMEOUT_MS
    int "MIDI1 serial Running status timeout (ms)"
    default 300

config MIDI1_SERIAL_ISR_MSGQ_SIZE_MS
    int "MIDI1 serial size of the MIDI serial UART rx message queue"
    default 128

config MIDI1_SERIAL_TX_BUF_SIZE
    int "MIDI1 serial UART transmit buffer size (bytes)"
    default 128
    help
      The size of the software ring buffer for interrupt-driven TX.
      A larger buffer prevents thread blocking but increases maximum
      MIDI latency if the buffer fills up.
```

## dts/bindings/midi/midi1_clock_meas_cntr.yaml
```yaml
# SPDX-License-Identifier: Apache-2.0

description: MIDI1 clock measurement system
compatible: "midi1_clock_meas_cntr"

properties:
  counter:
    type: phandle
    required: true
    description: counter device
```

## dts/bindings/midi/midi1_serial.yaml
```yaml
# SPDX-License-Identifier: Apache-2.0

description: MIDI1 UART-based MIDI driver
compatible: "midi1_serial"

properties:
  uart:
    type: phandle
    required: true
    description: UART device used for MIDI I/O
```

## lib/harmonic/Kconfig
```kconfig
# SPDX-License-Identifier: Apache-2.0

config MIDI1_HARMONIC
	bool "MIDI1 harmonic information module"
	default y
	help
	  Enable the harmonic information module which provides
	  data and functions for scales, chords, and notes.
```

## samples/midi1_octave_arp/sample.yaml
```yaml
# SPDX-License-Identifier: Apache-2.0

sample:
  name: MIDI 1.0 Octave-Doubled Arpeggiator Demo
tests:
  sample.midi1_octave_arp:
    platform_allow:
      - frdm_k64f
      - frdm_mcxc242
    harness: console
    harness_config:
      type: one_line
      regex:
        - "Arpeggiator running"
```

## tests/lib/midi1_parser/testcase.yaml
```yaml
# SPDX-License-Identifier: Apache-2.0

tests:
  drivers.midi.parser:
    tags: midi
    platform_allow:
      - native_sim
      - qemu_cortex_m0
      - qemu_cortex_m3
```

## west.yml
```yaml
manifest:
  remotes:
    - name: zephyrproject-rtos
      url-base: https://github.com/zephyrproject-rtos

  projects:
    - name: zephyr
      remote: zephyrproject-rtos
      import: true

  self:
    path: modules/lib/midi1
```
